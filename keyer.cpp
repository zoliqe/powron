/////
// CW KEYER functions
////
#include "Arduino.h"
#include "keyer.h"
#include "pins.h"

byte pin = 0; // keyed pin
byte ratio = 3;
unsigned int ditLength = 0;
unsigned int dahLength = 0;

void morseRatio(byte val) {
  ratio = val;
}

void morsePin(byte val) {
    pin = val;
}

void morseSpeed(byte wpm) {
	if (wpm >= 5 && wpm <= 40) {
	  ditLength = 1200 / wpm;
	  dahLength = ratio * 1200 / wpm;
	}
}

void morseDit() {
  if (pin == 0) return;
  digitalWrite(pin, HIGH);
  led(HIGH);
  delay(ditLength);
  digitalWrite(pin, LOW);
  led(LOW);
  delay(ditLength);
}

void morseDah() {
  if (pin == 0) return;
  digitalWrite(pin, HIGH);
  led(HIGH);
  delay(dahLength);
  digitalWrite(pin, LOW);
  led(LOW);
  delay(ditLength);
}

void morseSpace() {
  if (pin == 0) return;
  delay(dahLength);
}
