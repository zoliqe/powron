/*

*/
// #include <SoftwareSerial.h>
#include "pins.h"
#include "errors.h"
#include "watchdog.h"
#include "keyer.h"

// #include <WebUSB.h>
// WebUSB WebUSBSerial(1, "om4aa.ddns.net/remotig/pwa"); // 0 - http://, 1 - https://
// #define Serial WebUSBSerial
#define port Serial1

const byte version = 3;
const unsigned long baudrate = 4800; // 115200
const unsigned long heartbeat = 1; // ms
const unsigned long defaultTimeout = 600000; // ms
const byte defaultWpm = 28;
const byte ditDahRatio = 3;
const byte outPins[] = {2, 3, 4, 5, 6, 7, 8, 9, 10};
const byte inPins[] = {A0, A1, A2, A3, A4, A5, A6, A7};
// SoftwareSerial port(11, 12); // RX, TX
unsigned int value;
bool started = false;

void waitForStartSequence() {
  while (!started) {
    if (Serial && Serial.available()) {
      String seq = Serial.readStringUntil('\n');
      seq.trim();
      if (seq.endsWith("$OM4AA#")) {
        started = true;
      }
    }
    delay(100);
  }
  serialFlush();
}

void serialFlush() {
  while(Serial.available()) Serial.read();
}

void setup() {
  for (byte i = 0; i < sizeof(outPins); i++) {
    pinMode(outPins[i], OUTPUT);
    digitalWrite(outPins[i], LOW);
  }
  for (byte i = 0; i < sizeof(inPins); i++) {
    pinMode(inPins[i], INPUT);
  }
  
  setupWatchDog(sizeof(outPins), defaultTimeout);
  morsePin(0); // disabled by default
  morseRatio(ditDahRatio);
  morseSpeed(defaultWpm);
  
  Serial.begin(baudrate);
  while (!Serial) { }
  waitForStartSequence();
  Serial.println("OK");
}

void led(byte state) {
  digitalWrite(LED_BUILTIN, state);
}

bool readValue() {
  String val = Serial.readStringUntil('\n');
  bool digits = true;
  for (int i = 0; digits && i < val.length(); i++) { // validate
    digits = isDigit(val[i]);
  }
  
  if (digits && val.length() > 0) {
    value = val.toInt();
    return true;
  }
  E(EVAL);
  return false;
}

void on(byte i) {
  if (i >= sizeof(outPins)) {
    E(ERNG);
    return;
  }
  
  led(LOW);
  startTimer(i);
  
  digitalWrite(outPins[i], HIGH);
  Serial.print('H');
  Serial.print(i);
  Serial.println(":OK");
  led(HIGH);
}

void off(byte i) {
  if (i >= sizeof(outPins)) {
    E(ERNG);
    return;
  }

  led(LOW);
  digitalWrite(outPins[i], LOW);
  clearTimer(i);
  Serial.print('L');
  Serial.print(i);
  Serial.println(":OK");
  led(HIGH);
}

void in(byte i) {
  if (i >= sizeof(inPins)) {
    E(ERNG);
    return;
  }
  
  led(LOW);
  unsigned int val = analogRead(inPins[i]);
  Serial.print('I');
  Serial.print(i);
  Serial.print("=");
  Serial.println(val);
  led(HIGH);
}

void keyerOn(byte i) {
  if (i >= sizeof(outPins)) {
    E(ERNG);
  }

  led(LOW);
  morsePin(outPins[i]);
  Serial.print('K');
  Serial.print(i);
  Serial.println(":OK");
  led(HIGH);
}

void loop() {
  led(HIGH);
  if (Serial && Serial.available()) {
    char cmd = char(Serial.read());
    if (cmd == '\n' || cmd == '\r') return;
    
    // PINS
    if        (cmd == 'H') {
      if (readValue()) on(value);
    } else if (cmd == 'L') {
      if (readValue()) off(value);
    } else if (cmd == 'I') {
      if (readValue()) in(value);
    } else if (cmd == 'T') {
      if (readValue()) watchDogTimeout(value);
    } else if (cmd == '[') {
      Serial.print("ICNT=");
      Serial.println(sizeof(inPins));
    } else if (cmd == ']') {
      Serial.print("OCNT=");
      Serial.println(sizeof(outPins));
    // PORT
    } else if (cmd == 'P') {
      if (readValue()) {
        unsigned long baud = value * 100L;
        if (baud >= baudrate && baud <= 115200) {
          port.begin(baudrate);
          //port.println("::");
          // Serial.begin(baud);
          Serial.print('P');
          Serial.print(baud);
          Serial.println(":OK");
        // } else {
          // E(ERNG);
        }
      }
    } else if (cmd == '>') {
      port.print(Serial.readStringUntil('\n'));
    // KEYER
    } else if (cmd == 'K') {
      if (readValue()) keyerOn(value);
    } else if (cmd == 'S') {
      if (readValue()) morseSpeed(value);
    } else if (cmd == '.') {
      morseDit();
    } else if (cmd == '-') {
      morseDah();
    } else if (cmd == '_') {
      morseSpace();
    } else if (cmd == '?') {
      Serial.print("OK-");
      Serial.print(version);
      Serial.print(":");
      Serial.println(millis());
    } else {
      serialFlush();
      E(ECMD);
    }
  }
  
  watchDog();
  led(LOW);
  delay(heartbeat);
}

