#include "Arduino.h"
// #include "watchdog.h"
#include "errors.h"
#include "pins.h"

const unsigned long ulongMax = 0UL - 1UL;
unsigned long* startTimes; // = {0, 0, 0, 0, 0, 0, 0, 0, 0};
unsigned long* timeouts; // = {0, 0, 0, 0, 0, 0, 0, 0, 0};
byte pinsCount = 0;

void setupWatchDog(byte count, unsigned long timeout) {
  pinsCount = count;
  startTimes = new unsigned long[count];
  timeouts = new unsigned long[count];
  for (byte i = 0; i < count; i++) {
    startTimes[i] = 0;
    timeouts[i] = timeout;
  }
}

void watchDogTimeout(unsigned int value) {
  if (value < 1 || value >= 30000) {
    E(ERNG);
    return;
  }
  
  // led(LOW);
  for (int i = 0; i < pinsCount; i++) {
    timeouts[i] = value * 1000;
  }
  // led(HIGH);
}

void startTimer(byte pin) {
  if (pin >= pinsCount) return;
  unsigned long now = millis();
  startTimes[pin] = now > 0 ? now : 1; // 0 is reserved for OFF state
}

void clearTimer(byte pin) {
  if (pin >= pinsCount) return;
  startTimes[pin] = 0;
}

/** Calc time difference, accepting value rollover. */ 
unsigned long differenceOf(unsigned long now, unsigned long start) {
  return (now < start) ? (ulongMax - start + now) : (now - start);
}

void watchDog() {
  unsigned long now = millis();
  for (byte i = 0; i < pinsCount; i++) {
    unsigned long start = startTimes[i];
    unsigned long tout = timeouts[i];
    if (start > 0 && differenceOf(now, start) > tout) {
      off(i);
    }
  }
}

